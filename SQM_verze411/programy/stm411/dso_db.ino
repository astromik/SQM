
struct DSO_struktura
  {
    uint8_t    typ_dso;               // 1=dvojhvezda, 
                                      // 2=jasna mlhovina (Brt Neb)
                                      // 3=hvezdokupa s mlhovinou(CL+Neb)
                                      // 4=galaxie
                                      // 5=kulova hvezdokupa (Glb CL)
                                      // 6=otevrena hvezdokupa (Opn CL)
                                      // 7=planetarni mlhovina (Pln Neb)
                                      // 8=zbytek po vybuchu supernovy (SN Rem) 
                                      //      nejvyssi 4 bity obsahuji individualni korekci viditelnosti -0.7 az +0.7 mag 
                                      //                 (planovano hlavne pro otevrene hvezdokupy na bohatem hvezdnem pozadi, ktere jsou sice matematicky viditelne dobre, ale tezko se rozlisuji od okoli)

    uint16_t   RA_dso;                // rektascenze objektu zaokrouhlena na setiny stupne 0 az 360 stupnu = 0 - 36000 (jen pro vypocet polohy nad/pod horiontem)
    uint8_t    Dec_dso;               // deklinace objektu zaokrouhelna na stupne a zvetsena o 90 stupnu, aby se odstranily zaporne hodnoty (-90 az + 90 stupnu = 0 az 180) (jen pro vypocet polohy nad/pod horiontem) 
    uint8_t    mag_dso;               // jas objektu v desetinach magnitudy (pro DSO vzdycky kladne)
    uint8_t    SB_dso;                // Surface Brightness v desetinach mag/arcmin2 (plati hlavne pro mlhoviny a galaxie, pro hvezdokupy nebylo uvedeno)
    uint16_t   major_dso;             // hlavni (vetsi) osa v desetinach minuty    (35=3.5' ; 150=15' ; 7=0.7')
    uint16_t   minor_dso;             // vedlejsi osa v desetinach minuty  (35=3.5' ; 150=15' ; 7=0.7')
    uint16_t   ns_dso;                // pocet hvezd v hvezdokupe
    uint8_t    bs_dso;                // jas nejjasnejsi hvezdy v hvezdokupe, nebo centralni hvezdy v planetarni mlhovine v desetinach magnitudy (73 = 7.3 mag) 
  };

DSO_struktura vybrany_DSO;            // data aktualne vybraneho objektu se prekopiruji z databaze READ-ONLY KONSTANT do teto promenne

const DSO_struktura      pole_DSO[663] = 
  {//  typ ,   Ra  , Dec , mag , S.B., majo , mino ,  ns  ,  bs           index pole   oznaceni DSO
    {    0 ,     0 ,   0 ,   0 ,   0 ,    0 ,    0 ,    0 ,    0} ,        // [  0]   index 0 neni pouzity
    {    8 ,  8363 , 112 ,  84 , 110 ,   60 ,   40 ,    0 ,    0} ,        // [  1]    M1
    {    5 , 32338 ,  89 ,  65 , 110 ,  160 ,  160 ,    0 ,    0} ,        // [  2]    M2
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    {    3 , 32835 , 137 , 100 ,   0 ,  120 ,  120 ,   20 ,   96}          // [662]    IC5146
  };


// odkazy oznaceni NGC na index databaze
//   priklad: NGC247 odkazuje do "pole_DSO[]" na index 122
//        Pri listovani mezi NGC se pomoci tlacitek prepinaji indexy 0 az 651. 
//        Na displeji se zobrazuji hodnoty prvniho prvku pole (jsou sice vzestupne, ale jsou mezi nimi mezery)
//        Po stisku [OK] se z databaze "pole_DSO[]" vyberou hodnoty z indexu druheho prvku pole a probehne vypocet viditelnosti
//        Pro odkazy mensi nez 111 je odkaz zaroven i Messierovka (v poli nize jsou okomentovane)

const uint16_t NGC_pocet = 655;                // kvuli listovani v menu je tady uveden skutecny pocet NGC objektu (pocet je posledni obsazeny index + 1)

const uint16_t ngc_odkaz[655][2]=
  {//  NGC ,odkaz          index  Messier
    {   40 , 111 } ,   // [  0]  
    {   55 , 112 } ,   // [  1]  
    {  129 , 113 } ,   // [  2]  
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    { 7814 , 654 }     // [651]  
  };



const uint16_t IC_pocet = 8;                // kvuli listovani v menu je tady uveden skutecny pocet IC objektu (pocet je posledni obsazeny index + 1)

const uint16_t ic_odkaz[8][2]=
  {//  IC  ,odkaz          index  
    {  342 , 655 } ,   // [  0]
    {  405 , 656 } ,   // [  1]
    {  410 , 657 } ,   // [  2]
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    { 5146 , 662 }     // [  7]
  };


// pro Messierovky plati, ze M = odkaz. V rade nejsou zadne mezery, indexuje se od 1 do 110, proto neni treba delat prevodni tabulku ani celkovy pocet (vzdycky jich bude 110)
//    priklady: M78 odkazuje jednoduse na index "pole_DSO[]" cislo 78
//             M105 odkazuje na index 105 ...




//-------------------- vypocty viditelnosti DSO -------------------
void zobraz_zvolene_dso(uint8_t katalog, uint16_t index_kat)
  {
    bool vypadnout_z_detailu = false;
    bool predchozi_up = HIGH;
    bool predchozi_dn = HIGH;
    bool predchozi_ok = HIGH;
    uint32_t ok_casovani = millis();                                                           // pro mereni delky stisku tlactka OK
    DSO_viditelnost = 255;                                                                     // vysledek podprogramu pro urcovani viditelnosti se po vstupu do podprogramu maze (nastavuje mimo meze). Ke skutecnemu vypoctu dojde az po mereni jasu pozadi.

   
    if (katalog == 0)   DSO_index_DB = index_kat;
    if (katalog == 1)   DSO_index_DB = ngc_odkaz[index_kat][1];
    if (katalog == 2)   DSO_index_DB =  ic_odkaz[index_kat][1];
    // tady odkazuje promenna 'DSO_index_DB' na index hlavni databaze, ve ktere se nachazi zvoleny DSO objekt

    vybrany_DSO = pole_DSO[DSO_index_DB];          // vsechny parametry vybraneho DSO se z databaze prekopiruji do "pracovni" promenne 'vybrany_DSO'

    uint8_t detail_menu_dso = 113;    // pro listovani v detailech se pouzivaji polozky v definicich textu 113 - 122
                                                                                               // [113] magnituda objektu
                                                                                               // [114] delsi rozmer
                                                                                               // [115] kratsi rozmer
                                                                                               // [116] typ objektu
                                                                                               // [117] tvar objektu
                                                                                               // [118] Azimut
                                                                                               // [119] Elevace
                                                                                               // [120] pocet hvezd v OC
                                                                                               // [121] nejjasnejsi hvezda v OC
                                                                                               // [122] stupen viditelnosti


    uint8_t autodet = 113;                                                                        // automaticke cyklovani detailnich informaci ke zvolenemu DSO
    bool popisek = true;                                                                       // jako prvni se zobrazi popisek  ("MAGni") ...
    uint16_t interval_pauzy = 0;                                                               //  ... a zobrazi se okamzite
    uint32_t casovani_automatu = millis();
    uint32_t casovani_autoexit_detailu = millis();


    spolecne_DSO_vypocty();                                                                    // vypocty nekterych parametru DSO objektu do globalnich promennych (plocha, poloha, extinkce, )



    while (digitalRead(pin_tl_ok) == HIGH and digitalRead(pin_tl_up) == HIGH and digitalRead(pin_tl_dn) == HIGH)      // po zvoleni DSO se vsechny detailni informace zacnou stridat 
      {

        interrupty();                                                                          // odskoceni na test, jestli neni nejaky pozadavek o komunikaci, nebo jestli neni cas spustit automaticke mereni    

        if (millis()- casovani_autoexit_detailu > 120000UL)                                    // automaticke cyklovani trva uz moc dlouho, vypadnout do uvodni obrazovky
          {
            vypadnout_z_detailu = true;
            auto_exit_menu = true;
            break;
          }
        if (millis() - casovani_automatu > interval_pauzy)
          {
            if (popisek == true)                                                               // pri promenne popisek=true se zobrazi popis detailu
              {
                zobraz_text(autodet);                                                          // ("MA6ni", "MAJor", "Minor" ... "Vidit")
                interval_pauzy = 900;                                                          // jak dlouho bude svitit popisek, nez se prepise jeho hodnotou
                casovani_automatu = millis();
                popisek = false;                                                               // priste se bude zobrazovat hodnota
              }
            else
              {
                zobraz_detail_dso(autodet);                                                    // zobrazeni hodnoty k predchozimu popisku
                autodet ++;                                                                    // priprava na prepnuti na dalsi detailni informace
                if (autodet > 122) autodet = 113;                                              // po prekroceni maxima se zacina zase od "MA6ni" ( index 113)
                interval_pauzy = 1500;                                                         // jak dlouho bude svitit hodnota, nez se prepise nasledujicim popiskem
                casovani_automatu = millis();
                popisek = true;                                                                // priste se bude zobrazovat popisek
              }
          }
      }                                                                                        // z automatickeho cyklovani se vypadne stiskem libovolneho tlacitka
    
    delay(50);
    
    while (vypadnout_z_detailu == false)
      {
        // listovani v detailech DSO se neprovadi zrychlene, ale vzdycky jen na 1 klik (v okamziku stisku se zobrazi textovy popis, pri uvolneni se zobrazi prislusna hodnota)

        if (digitalRead(pin_tl_dn) == LOW and predchozi_dn == HIGH)                            // prave bylo stisknuto [DOLU]
          {
            predchozi_dn = LOW;
            casovani_autoexit_detailu = millis();                                              // kazdy stisk tlacitka oddaluje automaticke vypadnuti z menu
            delay(50);
            if(detail_menu_dso > 113) detail_menu_dso--;
            zobraz_text(detail_menu_dso);
          }

        if (digitalRead(pin_tl_dn) == HIGH and predchozi_dn == LOW)                            // prave bylo uvolneno [DOLU]
          {
            predchozi_dn = HIGH;
            delay(50);
            zobraz_detail_dso(detail_menu_dso);
          }

        if (digitalRead(pin_tl_up) == LOW and predchozi_up == HIGH)                            // prave bylo stisknuto [NAHORU]
          {
            predchozi_up = LOW;
            casovani_autoexit_detailu = millis();                                              // kazdy stisk tlacitka oddaluje automaticke vypadnuti z menu
            delay(50);
            if(detail_menu_dso < 122) detail_menu_dso++;
            zobraz_text(detail_menu_dso);
          }

        if (digitalRead(pin_tl_up) == HIGH and predchozi_up == LOW)                            // prave bylo uvolneno [NAHORU]
          {
            predchozi_up = HIGH;
            delay(50);
            zobraz_detail_dso(detail_menu_dso);
          }

        if (digitalRead(pin_tl_ok) == LOW and predchozi_ok == HIGH)                            // prave bylo stisknuto [OK]
          {
            predchozi_ok = LOW;
            casovani_autoexit_detailu = millis();                                              // kazdy stisk tlacitka oddaluje automaticke vypadnuti z menu
            delay(50);
            ok_casovani = millis();
            zobraz_text(68);                                                                   // "----"
          }

        if (digitalRead(pin_tl_ok) == LOW and predchozi_ok == LOW and (millis() - ok_casovani > 1000))     // trvani stisku OK trva delsi dobu, bude se merit jas
          {
            zobraz_text(8);                                                                    // "JA5  "
          }



        if (digitalRead(pin_tl_ok) == HIGH and predchozi_ok == LOW)                            // prave bylo uvolneno [OK]
          {
            predchozi_ok = HIGH;
            delay(50);
            if (millis()-ok_casovani > 1000)                                                   // dlouhy stisk [OK] zmeri jas pozadi
              {
                mereni(11);                                                                    // mereni jasu s prumerovanim, ale bez ukladani a vystupu do seriove linky
                DSO_MSA = int_svetlo;                                                          // zmerena hodnota jasu v mmag/arsec2 (v uint16_t formatu)
                               
                pocitej_viditelnost();
                detail_menu_dso = 122;
                zobraz_text(122);                                                              // "Vidit"
                delay(1000);
                zobraz_info_viditelnost();                                                     // zobrazi viditelnost vcetne informace o problemu pri nulove viditelnosti
              }
            else                                                                               // kratky stisk [OK] vypadne z menu detailu DSO
              {
                vypadnout_z_detailu = true;
              }
          }

        interrupty();                                                                          // odskoceni na test, jestli neni nejaky pozadavek o komunikaci, nebo jestli neni cas spustit automaticke mereni    
        
        if (millis() - casovani_autoexit_detailu > 120000UL)                                   // zadne tlacitko se nestisklo uz delsi dobu, vypadne se z podprogramu do hlavni smycky
          {
            vypadnout_z_detailu = true;
            auto_exit_menu = true;
          }
      
      }

  }
//--------------------------------------------------------------------------------


//--------------------------------------------------------------------------------
// zobrazi na displeji jednu z detailnich informaci vybraneho DSO objektu
//  112=magnituda, 113=hlavni osa .... 119=stupen viditelnosti
//  vsechny parametry z vybraneho objektu z databaze jsou prekopirovane do docasne strukturovane promenne 'vybrany_DSO.xxxx_dso'
//  predpoklada se, ze jsou vypoctene i dalsi globalni promenne ('obecna_elevace', 'obecny_azimut', 'DSO_viditelnost')
void zobraz_detail_dso(uint8_t index_menu_det)
  {
    if (index_menu_det == 113)                                    // magnituda z databaze
      {
        pozice_tecky = 1;                                         // v databazi je hodnota 10x zvetsena, na displeji se musi doplnit desetinna tecka
        zobraz_cislo(vybrany_DSO.mag_dso,0);
      }


    if (index_menu_det == 114)                                    // hlavni osa z databaze
      {
        pozice_tecky = 1;                                         // v databazi je hodnota 10x zvetsena, na displeji se musi doplnit desetinna tecka
        zobraz_cislo(vybrany_DSO.major_dso,0);
      }

    if (index_menu_det == 115)                                    // vedlejsi osa z databaze
      {
        pozice_tecky = 1;                                         // v databazi je hodnota 10x zvetsena, na displeji se musi doplnit desetinna tecka
        zobraz_cislo(vybrany_DSO.minor_dso,0);
      }

    if (index_menu_det == 116)                                    // typ objektu z databaze
      {
        switch(vybrany_DSO.typ_dso & 0b00001111)                  // osekani o pripadne individualni korekce
          {
            case 1:                                               // (dvoj)hvezda
              zobraz_text(128);                                   // "5tAr"
              break;

            case 2:                                               // emisni mlhovina
            case 7:                                               // planetarni mlhovina
            case 8:                                               // zbytek po vybuchu suprnovy
              zobraz_text(123);                                   // "nEbuL"
              break;

            case 3:                                               // hvezdokupa s mlhovinou
              zobraz_text(127);                                   // "cL.nEb"
              break;

            case 4:                                               // galaxie
              zobraz_text(125);                                   // "6ALAH"
              break;

            case 5:                                               // kulova hvezdokupa
              zobraz_text(126);                                   // "6L cL"
              break;

            case 6:                                               // otevrena hvezdokupa
              zobraz_text(124);                                   // "oP cL"
              break;
          }
      }

    if (index_menu_det == 117)                                    // tvar objektu (stupen plochy a excentricita)
      {                                                           //  
        zobraz_tvar(DSO_stupen_plochy,DSO_excentricita);          // na displeji se zobrazi info ve formatu "x-Ey.y" (priklad "3-E0.9" pro stredne velke DSO a temer kruhovity tvar)
      }

    if (index_menu_det == 118)                                    // vypocteny aktualni azimut objektu, zaokrouhleny na cela cisla
      {
        pozice_tecky = 0;        
        zobraz_cislo(obecny_azimut,0);
      }

    if (index_menu_det == 119)                                    // vypoctena aktualni elevace, zaokrouhlena n acela cisla
      {
        pozice_tecky = 0;        
        zobraz_cislo(obecna_elevace,0);
        if (obecna_elevace < 0) DSO_viditelnost = 6;              // neni videt z duvodu objektu pod horizontem
      }


    if (index_menu_det == 120)                                    // pocet hvezd v OC
      {
        pozice_tecky = 0;        
        zobraz_cislo(vybrany_DSO.ns_dso,0);
      }

    if (index_menu_det == 121)                                    // nejjasnejsi hvezda v OC
      {
        pozice_tecky = 1;                                         // v databazi je hodnota 10x zvetsena, na displeji se musi doplnit desetinna tecka
        zobraz_cislo(vybrany_DSO.bs_dso,0);
      }



    if (index_menu_det == 122)
      {
        pozice_tecky = 0;                                         // stupen viditelnosti se zobrazuje jednou cifrou na posledni segmentovce bez desetinne tecky
        zobraz_info_viditelnost();                                // zobrazi viditelnost vcetne informace o problemu pri nulove viditelnosti
      }    
  }



//----------------------------------------------------------------
// Podle globalnich promennych matematicky vypocte stupen viditelnosti vybraneho DSO objektu (1 - 5).
//    Neviditelny objekt je dale upresnen:  0 = moc svetla; 6 = pod horizontem
void pocitej_viditelnost(void)
  {

    
    // vstupni globalni parametry:
    // -------------------------------------
//    Serial.print("DSO_MSA = ");
//    Serial.println(DSO_MSA);
//    Serial.print("obecna_elevace = ");
//    Serial.println(obecna_elevace);
//    Serial.print("DSO_extinkce = ");
//    Serial.println(DSO_extinkce);
//    Serial.print("DSO_schopnosti = ");
//    Serial.println(DSO_schopnosti);
//    Serial.print("DSO_pozorovatel = ");
//    Serial.println(DSO_pozorovatel);
//    Serial.print("DSO_zvetseni = ");
//    Serial.println(DSO_zvetseni);
//    Serial.print("DSO_vystupni_pupila = ");
//    Serial.println(DSO_vystupni_pupila);
//    Serial.print("DSO_delta_SB = ");
//    Serial.println(DSO_delta_SB);
//    Serial.print("vybrany_DSO.mag_dso = ");
//    Serial.println(vybrany_DSO.mag_dso);
//    Serial.print("vybrany_DSO.typ_dso vcetne individual = ");
//    Serial.println(vybrany_DSO.typ_dso, BIN);
//    Serial.print("vybrany_DSO.minor_dso = ");
//    Serial.println(vybrany_DSO.minor_dso);
//    Serial.print("vybrany_DSO.major_dso = ");
//    Serial.println(vybrany_DSO.major_dso);
//    Serial.print("vybrany_DSO.SB_dso = ");
//    Serial.println(vybrany_DSO.SB_dso);
//    Serial.print("vybrany_DSO.ns_dso = ");
//    Serial.println(vybrany_DSO.ns_dso);
//    Serial.print("vybrany_DSO.bs_dso = ");
//    Serial.println(vybrany_DSO.bs_dso);

    if (obecna_elevace < 0)                                       // pro zaporne elevace se ani nic nepocita a rovnou se vrati stupen 6
      {
        DSO_viditelnost = 6;                                      // neni videt z duvodu objektu pod horizontem
        return;
      }


    if ((vybrany_DSO.typ_dso & 0b00001111) == 6)                  // pro otevrene hvezdokupy se provadi vypocet pres pocet hvezd a nejjasnejsi hvezdy
      {
        DSO_viditelnost = vypocet_OC();                           // vsechny vypocty pracuji s globalnimi promennymi, takze neni nutne nic predavat. Navratova hodnota je stupen 0 az 5
      }
    else                                                          // pro galaxie, mlhoviny a kulove hvezdokupy se provadi vypocet pres Surface Brightness
      {
        DSO_viditelnost = vypocet_GLX();                          // vsechny vypocty pracuji s globalnimi promennymi, takze neni nutne nic predavat.  Navratova hodnota je stupen 0 az 5
      }

//    Serial.print("DSO_viditelnost = ");
//    Serial.println(DSO_viditelnost);
  }
//---------------------------------------------------------------------


//---------------------------------------------------------------------
// Ke zvolenemu DSO vypocte nektere parametry, ktere se pak pouzivaji v obou metodach vypoctu (GLX i OC)   
// vstupy i vystupy jsou globalni promenne
//  vstupni parametry jsou globalni promenne:
//     uint16_t    vybrany_DSO.RA_dso                        ... rektascenze zvoleneho objektu v setinach stupne (12345 = 123.45 stupnu = 8.23 hod)
//     uint8_t     vybrany_DSO.Dec_dso                       ... deklinace zvoleneho objektu ve stupnich s posunem o 90 stupnu (130 = +40 stupnu; 50 = -40 stupnu)
//     uint16_t    vybrany_DSO.major_dso                     ... velikost hlavni osy DSO objektu v desetinach uhlove minuty  
//     uint16_t    vybrany_DSO.minor_dso                     ... velikost vedlejsi osy DSO objektu v desetinach uhlove minuty  
//     uint16_t    DSO_delka_dalekohledu                     ... ohniskova delka hlavniho zrcadla v mm
//     uint8_t     DSO_delka_okularu                         ... ohniskova delka zvoleneho okularu v mm
//     uint8_t     DSO_schopnosti                            ... stupen  schopnosti pozorovatele 1 az 5, ze ktereho se pocita 'DSO_pozorovatel'
//     float       DSO_zornice_mm                            ... konstanta 7.0 (obvykly prumer zornice oka), neni uzivatelsky editovatelna, ale da se nastavit pred kompilaci programu
//     sada globalnich promennych s datumem, casem a GPS polohou stanoviste pro vypocty azimutu a elevace DSO
// vystupy se nastavuji take jako globalni promenne
//     float       DSO_extinkce                              ... vliv tloustky atmosfery na zaklade elevace objektu
//     float       obecny_azimut                             ... na zaklade rovnikovych souradnic, polohy pozorovatele a casu spocte aktualni azimut objektu
//     float       obecna_elevace                            ... na zaklade rovnikovych souradnic, polohy pozorovatele a casu spocte aktualni elevaci objektu
//     uint8_t     DSO_excentricita                          ... pro zobrazeni hrubeho tvaru na displeji (rozsah hodnot 1 pro uzke objekty az 10 pro kruhove objekty)
//     float       DSO_plocha                                ... plocha objektu spocitana z hlavni a vedlejsi osy jako plocha elipsy v [arcmin2]
//     uint8_t     DSO_stupen_plochy                         ... pro hrube zobrazeni velikosti objektu na displeji v rozsahu 1 pro male objekty az 5 pro velke objekty
//     float       DSO_zvetseni                              ... pomer ohniska hlavniho zrcadla a ohniska zvoleneho okularu
//     float       DSO_delta_SB                              ... vliv dalekohledu
//     float       DSO_pozorovatel                           ... pozorovatele

void spolecne_DSO_vypocty(void)
  {
    // -----  prepocet rovnikovych souradnic na azimut a elevaci ------------
    if (leto == true) casova_zona = letni_posun;
    else              casova_zona = zimni_posun;

    float RaHod = vybrany_DSO.RA_dso / 1500.0;                                      // databazove RA v setinach stupne prepocitat na hodiny
    float DecStup = vybrany_DSO.Dec_dso - 90;                                       // databazove Dec prepocitat na +/- 90 stupnu
    
    zobraz_RTC(false);                                                                         // aktualizace promennych s lokalnim casem 'LOC_...'
    z_LOC_na_Astro_UTC(casova_zona);                                                           // z globalnich promennych pro casove udaje v mistni casove zone (LOC_xxx) vypocte UTC datum a cas
    RaToAzim ( 3 ,    RaHod   ,  DecStup , LOC_rok , LOC_mes , LOC_den , LOC_hod , LOC_min , casova_zona , GeoLon , GeoLat );       // obecne teleso

    obecny_azimut  = round(obecny_azimut);                                                     // zaokrouhleni azimutu na cele stupne
    if (obecny_azimut == 360) obecny_azimut = 0;                                               // osetreni zaokrouhleni tesne pred severem (napriklad 359.7 stupne by se zaokrouhlilo na nesmyslnych 360)
   
    obecna_elevace = round(obecna_elevace);                                                    // zaokrouhleni elevace na cele stupne
    //-----------------------------------------------------------------------

    DSO_zvetseni = DSO_delka_dalekohledu / DSO_delka_okularu;                                  // vypocet dalekohledu podle nastavenych parametru (prumer, ohniska ...)
    float ratio = (DSO_zornice_mm * DSO_zvetseni) / DSO_prumer_dalekohledu;
    DSO_delta_SB = 5.0 * log10(ratio);

    DSO_excentricita = 100 * ((sqrtf(pow(vybrany_DSO.major_dso,2) - pow(vybrany_DSO.minor_dso,2)) / vybrany_DSO.major_dso)+0.005);

    if (DSO_excentricita > 99) DSO_excentricita = 99;

    
    DSO_plocha = (PI *  vybrany_DSO.major_dso * vybrany_DSO.minor_dso) / 400.0;       
  
    if      (DSO_plocha > 1000) DSO_stupen_plochy = 5;               // nejvetsi plocha objeku       - statisticke rozlozeni odpovida asi  25 DSO
    else if (DSO_plocha >   60) DSO_stupen_plochy = 4;               //                                statisticke rozlozeni odpovida asi 185 DSO
    else if (DSO_plocha >   11) DSO_stupen_plochy = 3;               // stredne velka plocha objektu - statisticke rozlozeni odpovida asi 240 DSO
    else if (DSO_plocha >    3) DSO_stupen_plochy = 2;               //                                statisticke rozlozeni odpovida asi 151 DSO
    else                        DSO_stupen_plochy = 1;               // nejmensi plocha objektu      - statisticke rozlozeni odpovida asi  60 DSO

    DSO_extinkce = 1.3 * exp(-0.04 * obecna_elevace);                // vliv tloustky atmosfery (nelinearni podle aktualni elevace) v rozsahu 0 stupnu = 1,3 az 90 stupnu = 0,04

    DSO_pozorovatel = (DSO_schopnosti - 3) * 0.3;                    // prevod ze stupne schopnosti na pridavek/ubytek magnitudy

    // doplnena moznost mirne individualni (kladna nebo zaporna) korekce viditelnosti (napriklad u otevrenych hvezokup, ktere se nachazi na bohatem hvezdnem pozadi)
    uint8_t individualni_stupen = ((vybrany_DSO.typ_dso & 0b11110000) >> 4);        // prevod hornich 4 bitu na cislo 0 az 15

    //                                bit 3 = kladne nebo zaporne znamenko           bity 0 az 3 = absolutni hodnota
    DSO_individualni_korekce = ((individualni_stupen & 0b00001000) ? -1.0 : 1.0) * (individualni_stupen & 0b00000111) * 0.1; 
    
  }
//---------------------------------------------------------------------



//---------------------------------------------------------------------
//  Vypocet stupne viditelnosti DSO pro otevrene hvezdokupy
//
//  vstupni parametry jsou globalni promenne:
//     uint16_t    vybrany_DSO.major_dso                     ... velikost hlavni osy DSO objektu v desetinach uhlove minuty  
//     uint16_t    vybrany_DSO.minor_dso                     ... velikost vedlejsi osy DSO objektu v desetinach uhlove minuty  
//     uint8_t     vybrany_DSO.bs_dso                        ... jas nejjasnejsi hvezdy v hvezdokupe v desetinach magnitudy
//     uint16_t    vybrany_DSO.ns_dso                        ... pocet hvezd v hvezokupe
//     float       DSO_plocha                                ... plocha DSO obektu spoctena z hlavni a vedlejsi osy jako plocha elipsy (v uhlovych minutach)
//     uint16_t    DSO_MSA                                   ... zmereny jas oblohy v tisicinach mag/arcsek2 (kvuli zobrazovani na displeji) priklad 21754 = 21.754 mag/arcsek2
//     float       DSO_pozorovatel                           ... schopnosti pozorovatele
//     float       DSO_extinkce                              ... vliv tloustky atmosfery na zaklade elevace objektu
//     uint8_t     DSO_normal                                ... kalibracni konstanta pro hodnoceni viditelnosti otevrenych hvezdokup v desetinach [mag/arcsek2]
//     uint16_t    DSO_prumer_dalekohledu                    ... prumer dalekohledu v [mm]
//     float       DSO_zornice_mm                            ... konstanta 7.0 (obvykly prumer zornice oka), neni uzivatelsky editovatelna, ale da se nastavit pred kompilaci programu
// Navratova hodnota je stupen viditelnosti 1 az 5

uint8_t vypocet_OC(void)
  {
    float lm_eye =  6.5 + DSO_pozorovatel;                                    // limitni magnituda oka je zavisla na stupni schopnosti pozorovatele
    float lm_scope = lm_eye + (5.0 * log10(DSO_prumer_dalekohledu / DSO_zornice_mm));    // limitni magnituda dalekohledu je zavisla hlavne na prumeru
    lm_scope= lm_scope - ((DSO_normal/10.0) - (DSO_MSA/1000.0));              // Zmerena hodnota jasu MSA je v tisicinach mag/arcsec2, normalovy jas je v desetinach mag/arcsec2
    
    float delta_star = lm_scope - (vybrany_DSO.bs_dso / 10.0);                // Viditelnost nejjasnejsi hvezdy 
    float density = vybrany_DSO.ns_dso / DSO_plocha;                          // Hvezdna hustota
    float densityScore = log10(density);                                      // oko reaguje logaritmicky
    float score = (1.2 * delta_star) + (1.0 * densityScore) - (0.8 * DSO_extinkce) + DSO_pozorovatel;  // celkove skore

    score = score + DSO_individualni_korekce;                                 // zapocteni pripadne individualni korekce

    // DEBUG
    // Serial.print("lm_eye = ");
    // Serial.println(lm_eye,4);
    // Serial.print("lm_scope = ");
    // Serial.println(lm_scope,4);
    // Serial.print("delta_star = ");
    // Serial.println(delta_star,4);
    // Serial.print("density = ");
    // Serial.println(density,4);
    // Serial.print("densityScore = ");
    // Serial.println(densityScore,4);
    // Serial.print("score = ");
    // Serial.println(score,4);

    if (score < -1.5) return 0;                            // prevod 'score' na stupen viditelnosti 
    if (score < -0.8) return 1;
    if (score < -0.2) return 2;
    if (score <  0.5) return 3;
    if (score <  1.2) return 4;
    return 5;
  }
//---------------------------------------------------------------------


//---------------------------------------------------------------------
//  Vypocet stupne viditelnosti DSO pro galaxie, mlhoviny a kulove hvezdokupy
//
//  vstupni parametry jsou globalni promenne:
//     uint16_t    vybrany_DSO.major_dso                     ... velikost hlavni osy DSO objektu v desetinach uhlove minuty  
//     uint16_t    vybrany_DSO.minor_dso                     ... velikost vedlejsi osy DSO objektu v desetinach uhlove minuty  
//     uint8_t     vybrany_DSO.SB_dso                        ... plosny Surface Brightness objektu v desetinach mag/arcmin2   
//     uint8_t     vybrany_DSO.typ_dso                       ... typ objektu (galaxie, mlhovina, hvezdokupa ...)   
//     float       DSO_plocha                                ... plocha DSO obektu spoctena z hlavni a vedlejsi osy jako plocha elipsy (v uhlovych minutach)
//     uint16_t    DSO_MSA                                   ... zmereny jas oblohy v tisicinach mag/arcsek2 (kvuli zobrazovani na displeji) priklad 21754 = 21.754 mag/arcsek2
//     float       DSO_pozorovatel                           ... schopnopsti pozorovatele
//     float       DSO_delta_SB                              ... prinos dalekohledu (okular, prumer, ohnisko)
//     float       DSO_extinkce                              ... vliv tloustky atmosfery na zaklade elevace objektu
//
// Navratova hodnota je stupen viditelnosti 1 az 5

uint8_t vypocet_GLX(void)
  {
    float velikostni_penalizace_velke = 0.6 * log10(sqrtf((vybrany_DSO.minor_dso/10.0) * (vybrany_DSO.major_dso / 10.0)));
    float velikostni_penalizace_male = 0;
   
     if (vybrany_DSO.major_dso < 20 or vybrany_DSO.minor_dso < 20)   // pro objekty pod 2 uhlove minuty v nektere ose se pocita velikostni penalizace 
       {
         velikostni_penalizace_male = 1.2 * log10(2/ sqrtf(DSO_plocha));
       }
              // prictenim 8.89 se prevadi jas z databaze z [mag/arcmin2] na [mag/arcsec2]        = 2.5 * LOG10(60*60)
    float SB_object_eff = (8.89 + (vybrany_DSO.SB_dso / 10.0)) + DSO_delta_SB + DSO_extinkce + velikostni_penalizace_velke + velikostni_penalizace_male;

    float kontrast = (DSO_MSA / 1000.0) - SB_object_eff;
    kontrast = kontrast + DSO_pozorovatel;                        // zapocteni vlivu schopnosti pozorovatele

    switch (vybrany_DSO.typ_dso & 0b00001111)                     // zapocteni vlivu typu DSO (nejvyssi 4 bity obsahuji pripadnou individualni korekci a proto se musi oseknout)
      {
        case 2:                                                   // jasna mlhovina
          kontrast = kontrast + 0.4;
          break;
          
        case 3:                                                   // hvezdokupa + mlhovina
          kontrast = kontrast + 0.2;
          break;
          
        case 4:                                                   // galaxie
          kontrast = kontrast + 0.0;
          break;
  
        case 7:                                                   // planetarni mlhovina
          kontrast = kontrast + 0.6;
          break;

        case 8:                                                   // SN remnant
          kontrast = kontrast + 0.1;
          break;

        default:  
          kontrast = kontrast + 0.0;
        
      }

    kontrast = kontrast + DSO_individualni_korekce;                // zapocteni pripadne individualni korekce


    // DEBUG
    // Serial.print("velikostni_penalizace_velke = ");
    // Serial.println(velikostni_penalizace_velke,4);
    // Serial.print("velikostni_penalizace_male = ");
    // Serial.println(velikostni_penalizace_male,4);
    // Serial.print("SB_object_eff = ");
    // Serial.println(SB_object_eff,4);
    // Serial.print("kontrast (po zapocteni pozorovate, typu objektu a individualni korekce) = ");
    // Serial.println(kontrast,4);

    if      (kontrast < -3.0)  return 0;               // prevod kontrastu na stupnici viditelnosti 0 az 5
    else if (kontrast < -2.3)  return 1;
    else if (kontrast < -1.7)  return 2;
    else if (kontrast < -1.0)  return 3;
    else if (kontrast < -0.3)  return 4;
    else                       return 5;

  }
//---------------------------------------------------------------------



//---------------------------------------------------------------------
// zobrazi viditelnost vcetne informace o problemu pri nulove viditelnosti "ELE-0" 
//  specialni pripad, kdy se viditelnost nepocita, jsou hvezdokupy, ktere nemaji v databazi uveden Surface Brightness
void zobraz_info_viditelnost(void)
  {
    if (DSO_viditelnost < 255)                              // kdyz uz probehlo mereni jasu pozadi a vypocetl se stupen viditelnosti 0 az 5
      {
        if (DSO_viditelnost == 6)
          {
            zobraz_text(129);                               // "ELE-0"
          }
        else
          {
            zobraz_cislo(DSO_viditelnost,0);            
          }
      }
    else                                                    // jeste nebylo zmereno pozadi, proto se stupen viditelnosti nepocita
      {
        zobraz_text(68);                                    // "-----"
      }
  }
//--------------------------------------------------------------------------------




//--------------------------------------------------------------------------------
// zobrazi na displeji slozenou informaci o velikosti plochy a excentricite vybraneho DSO
// promenna 'elipsa' (setiny excentricity) nesmi byt ani po zaokrouhleni vetsi nez 99
void zobraz_tvar(uint8_t plocha , uint8_t elipsa)
  {
    if (plocha > 5)   D_pamet[4] = 8;                           // "_" kdyz je stupen plochy mimo povoleny rozsah (normalne by k tomu dojit nemelo)
    else              D_pamet[4] =  graf_def[plocha];           // cislo, kdyz je stupen plochy v predpokladanem rozsahu 0 az 5

    D_pamet[3] = 64;                                            // druha segmentovka zleva vzdycky oddelovaci pomlcka
    D_pamet[2] = 121 + 128;                                     // prostredni segmentovka vzdycky "E." jako oznaceni excentricity (tecka ma funkci desetinne tecky pro nasledujici dve cifry)

    D_pamet[1] = graf_def[elipsa / 10];                         // druha segmentovka zprava jako desetiny excentricity
    D_pamet[0] = graf_def[elipsa % 10];                         // segmentovka uplne vpravo jako setiny excentricity

    aktualizuj_displej();
  
  }
